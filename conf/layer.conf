## conf/layer.conf
```bitbake
# We have a conf and classes directory, add to BBPATH
BBPATH .= ":${LAYERDIR}"

# We have recipes-* directories, add to BBFILES
BBFILES += "${LAYERDIR}/recipes-*/*/*.bb \
            ${LAYERDIR}/recipes-*/*/*.bbappend"

BBFILE_COLLECTIONS += "meta-worker"
BBFILE_PATTERN_meta-worker = "^${LAYERDIR}/"
BBFILE_PRIORITY_meta-worker = "6"

LAYERDEPENDS_meta-worker = "core"
LAYERSERIES_COMPAT_meta-worker = "hardknott"
```
